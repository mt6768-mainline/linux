// SPDX-License-Identifier: GPL-2.0-only
/*
 * Device Tree Source for Xiaomi Redmi 9 with Huaxing FT8719 panel and Kinetic KTD3137 backlight
 */

/dts-v1/;

#include "mt6769t-xiaomi-common.dtsi"
#include "mt6769t-xiaomi-lancelot-huaxing.dtsi"
#include "mt6769t-xiaomi-lancelot-ktd.dtsi"
