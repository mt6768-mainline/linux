## Documentation/devicetree/bindings/clock/mediatek,mt6768-clock.yaml
```yaml
# SPDX-License-Identifier: (GPL-2.0 OR BSD-2-Clause)
%YAML 1.2
---
$id: http://devicetree.org/schemas/clock/mediatek,mt6768-clock.yaml#
$schema: http://devicetree.org/meta-schemas/core.yaml#

title: MediaTek Functional Clock Controller for MT6768

maintainers:
  - Roman Vivchar <rva333@protonmail.com>

description: |
  The clock architecture in MediaTek like below
  PLLs -->
          dividers -->
                      muxes
                           -->
                              clock gate

  The devices provide clock gate control in different IP blocks.

properties:
  compatible:
    items:
      - enum:
          - mediatek,mt6768-imgsys
          - mediatek,mt6768-camsys
          - mediatek,mt6768-mipi0a
          - mediatek,mt6768-mipi0b
          - mediatek,mt6768-mipi1a
          - mediatek,mt6768-mipi1b
          - mediatek,mt6768-mipi2a
          - mediatek,mt6768-mipi2b
          - mediatek,mt6768-vdecsys
      - const: syscon
  reg:
    maxItems: 1

  '#clock-cells':
    const: 1

required:
  - compatible
  - reg

additionalProperties: false

examples:
  - |
    imgsys: clock-controller@15020000 {
        compatible = "mediatek,mt6768-imgsys", "syscon";
        reg = <0x15020000 0x1000>;
        #clock-cells = <1>;
    };
```

## Documentation/devicetree/bindings/clock/mediatek,mt6768-sys-clock.yaml
```yaml
# SPDX-License-Identifier: (GPL-2.0 OR BSD-2-Clause)
%YAML 1.2
---
$id: http://devicetree.org/schemas/clock/mediatek,mt6768-sys-clock.yaml#
$schema: http://devicetree.org/meta-schemas/core.yaml#

title: MediaTek System Clock Controller for MT6768

maintainers:
  - Roman Vivchar <rva333@protonmail.com>

description: |
  The clock architecture in MediaTek like below
  PLLs -->
          dividers -->
                      muxes
                           -->
                              clock gate

  The apmixedsys provides most of PLLs which generated from SoC 26 MHz clock.
  The topckgen provides dividers and muxes which provide the clock source to other IP blocks.
  The infracfg_ao provides clock gate in peripheral and infrastructure IP blocks.
  The mcucfg provides mux control to select the clock source in the AP.
  The device nodes also provide the system control capacity for configuration.

properties:
  compatible:
    items:
      - enum:
          - mediatek,mt6768-mcucfg
          - mediatek,mt6768-topckgen
          - mediatek,mt6768-infracfg-ao
          - mediatek,mt6768-apmixedsys
      - const: syscon

  reg:
    maxItems: 1

  '#clock-cells':
    const: 1

  '#reset-cells':
    const: 1

required:
  - compatible
  - reg

additionalProperties: false

examples:
  - |
    topckgen: syscon@10000000 {
        compatible = "mediatek,mt6768-topckgen", "syscon";
        reg = <0x10000000 0x1000>;
        #clock-cells = <1>;
    };
```

## Documentation/devicetree/bindings/leds/backlight/kinetic,ktd3137.yaml
```yaml
# SPDX-License-Identifier: (GPL-2.0-only OR BSD-2-Clause)
%YAML 1.2
---
$id: http://devicetree.org/schemas/leds/backlight/kinetic,ktd3137.yaml#
$schema: http://devicetree.org/meta-schemas/core.yaml#

title: Kinetic Technologies KTD3137 LED Backlight

maintainers:
  - Roman Vivchar <rva333@protonmail.com>

description:
  The Kinetic Technologies KTD3137 is an I2C LED backlight driver for medium
  to large size LCD panels.

allOf:
  - $ref: common.yaml#

properties:
  compatible:
    const: kinetic,ktd3137

  reg:
    maxItems: 1

  default-brightness:
    maximum: 2047
    default: 2047

  enable-gpios:
    maxItems: 1
    description: GPIO connected to the HWEN pin.

  led-max-microamp:
    minimum: 5000
    maximum: 29800
    default: 20200

  vin-supply: true

required:
  - compatible
  - reg
  - vin-supply

unevaluatedProperties: false

examples:
  - |
    #include <dt-bindings/gpio/gpio.h>

    i2c {
        #address-cells = <1>;
        #size-cells = <0>;

        backlight@36 {
            compatible = "kinetic,ktd3137";
            reg = <0x36>;
            enable-gpios = <&pio 160 GPIO_ACTIVE_HIGH>;
            led-max-microamp = <20200>;
            default-brightness = <2047>;
            vin-supply = <&vsys>;
        };
    };
```

## Documentation/devicetree/bindings/pinctrl/mediatek,mt6768-pinctrl.yaml
```yaml
# SPDX-License-Identifier: (GPL-2.0-only OR BSD-2-Clause)
%YAML 1.2
---
$id: http://devicetree.org/schemas/pinctrl/mediatek,mt6768-pinctrl.yaml#
$schema: http://devicetree.org/meta-schemas/core.yaml#

title: MediaTek MT6768 Pin Controller

maintainers:
  - Roman Vivchar <rva333@protonmail.com>

description:
  The MediaTek's MT6768 Pin controller is used to control SoC pins.

properties:
  compatible:
    const: mediatek,mt6768-pinctrl

  gpio-controller: true

  '#gpio-cells':
    description:
      Number of cells in GPIO specifier. Since the generic GPIO binding is used,
      the amount of cells must be specified as 2. See the below mentioned gpio
      binding representation for description of particular cells.
    const: 2

  gpio-ranges:
    maxItems: 1

  gpio-line-names: true

  reg:
    description:
      Physical address base for GPIO base registers. There are 10 different GPIO
      physical address base in mt6768.
    maxItems: 10

  reg-names:
    description:
      GPIO base register names.
    items:
      - const: gpio
      - const: iocfg_lt
      - const: iocfg_lm
      - const: iocfg_lb
      - const: iocfg_bl
      - const: iocfg_rm
      - const: iocfg_rb
      - const: iocfg_rt
      - const: iocfg_tl
      - const: eint

  interrupt-controller: true

  '#interrupt-cells':
    const: 2

  interrupts:
    description: The interrupt outputs to sysirq
    maxItems: 1

patternProperties:
  '-pins$':
    type: object
    additionalProperties: false
    patternProperties:
      '^pins':
        type: object
        additionalProperties: false
        description: |
          A pinctrl node should contain at least one subnodes representing the
          pinctrl groups available on the machine. Each subnode will list the
          pins it needs, and how they should be configured, with regard to muxer
          configuration, pullups, drive strength, input enable/disable and input
          schmitt.
          An example of using macro:
          pincontroller {
            /* GPIO0 set as multifunction GPIO0 */
            gpio-pins {
              pins {
                pinmux = <PINMUX_GPIO0__FUNC_GPIO0>;
              }
            };
            /* GPIO82 set as multifunction SDA0 */
            i2c0-pins {
              pins {
                pinmux = <PINMUX_GPIO82__FUNC_SDA0>;
              }
            };
          };
        $ref: pinmux-node.yaml

        properties:
          pinmux:
            description:
              Integer array, represents gpio pin number and mux setting.
              Supported pin number and mux varies for different SoCs, and are
              defined as macros in dt-bindings/pinctrl/<soc>-pinfunc.h directly.

          drive-strength:
            enum: [2, 4, 6, 8, 10, 12, 14, 16]

          drive-strength-microamp:
            enum: [125, 250, 500, 1000]

          bias-pull-down:
            oneOf:
              - type: boolean
              - enum: [100, 101, 102, 103]
                description: mt6768 pull down PUPD/R0/R1 type define value.

          bias-pull-up:
            oneOf:
              - type: boolean
              - enum: [100, 101, 102, 103]

          bias-disable: true

          output-high: true

          output-low: true

          input-enable: true

          input-disable: true

          input-schmitt-enable: true

          input-schmitt-disable: true

        required:
          - pinmux

required:
  - compatible
  - reg
  - interrupts
  - interrupt-controller
  - '#interrupt-cells'
  - gpio-controller
  - '#gpio-cells'
  - gpio-ranges

additionalProperties: false

examples:
  - |
    #include <dt-bindings/pinctrl/mt6768-pinfunc.h>
    #include <dt-bindings/interrupt-controller/arm-gic.h>

    pio: pinctrl@10005000 {
        compatible = "mediatek,mt6768-pinctrl";
        reg = <0 0x10005000 0 0x1000>,
              <0 0x10002000 0 0x200>,
              <0 0x10002200 0 0x200>,
              <0 0x10002400 0 0x200>,
              <0 0x10002600 0 0x200>,
              <0 0x10002800 0 0x200>,
              <0 0x10002a00 0 0x200>,
              <0 0x10002c00 0 0x200>,
              <0 0x10002e00 0 0x200>,
              <0 0x1000b000 0 0x1000>;
        reg-names = "gpio", "iocfg_lt", "iocfg_lm", "iocfg_lb",
                "iocfg_bl", "iocfg_rm", "iocfg_rb", "iocfg_rt",
                "iocfg_tl", "eint";
        gpio-controller;
        #gpio-cells = <2>;
        gpio-ranges = <&pio 0 0 187>;
        interrupt-controller;
        interrupts = <GIC_SPI 186 IRQ_TYPE_LEVEL_HIGH>;
        #interrupt-cells = <2>;
    };
```

## Documentation/devicetree/bindings/power/supply/mediatek,mt6358-gauge.yaml
```yaml
# SPDX-License-Identifier: (GPL-2.0-only OR BSD-2-Clause)
%YAML 1.2
---
$id: http://devicetree.org/schemas/power/supply/mediatek,mt6358-gauge.yaml#
$schema: http://devicetree.org/meta-schemas/core.yaml#

title: MediaTek MT6358 Fuel Gauge

maintainers:
  - Roman Vivchar <rva333@protonmail.com>

description:
  The MT6358 fuel gauge provides voltage, current, average current, and
  accumulated charge (coulomb counter) measurements for the attached
  battery.

allOf:
  - $ref: power-supply.yaml#

properties:
  compatible:
    const: mediatek,mt6358-gauge

  io-channels:
    items:
      - description: Battery voltage ADC channel

  nvmem-cells:
    items:
      - description: RTC spare cell for initialization flag
      - description: RTC spare cell for saved state-of-charge

  nvmem-cell-names:
    items:
      - const: initialization
      - const: state-of-charge

  shunt-resistor-micro-ohms:
    description: Shunt resistor value in micro-ohms
    default: 10000

  mediatek,car-tune-value:
    $ref: /schemas/types.yaml#/definitions/uint32
    description: Tuning factor for coulomb counter in per-mille
    default: 1000

  monitored-battery: true

required:
  - compatible
  - io-channels

additionalProperties: false

examples:
  - |
    #include <dt-bindings/iio/adc/mediatek,mt6358-auxadc.h>

    fuel-gauge {
        compatible = "mediatek,mt6358-gauge";
        io-channels = <&pmic_adc MT6358_AUXADC_BATADC>;
        nvmem-cells = <&fg_init>, <&fg_soc>;
        nvmem-cell-names = "initialization", "state-of-charge";
        shunt-resistor-micro-ohms = <10000>;
        mediatek,car-tune-value = <990>;
        monitored-battery = <&battery>;
    };
```

## Documentation/devicetree/bindings/power/supply/qcom,smb1351.yaml
```yaml
# SPDX-License-Identifier: (GPL-2.0-only OR BSD-2-Clause)
%YAML 1.2
---
$id: http://devicetree.org/schemas/power/supply/qcom,smb1351.yaml#
$schema: http://devicetree.org/meta-schemas/core.yaml#

title: Qualcomm / Summit Microelectronics SMB1351 Battery Charger

maintainers:
  - Roman Vivchar <rva333@protonmail.com>

description:
  The SMB1351 is a single-cell switch-mode battery charger with power path
  management and integrated USB-OTG boost regulator.

properties:
  compatible:
    const: qcom,smb1351-charger

  reg:
    maxItems: 1

  interrupts:
    maxItems: 1

  enable-gpios: true

  monitored-battery:
    $ref: /schemas/types.yaml#/definitions/phandle
    description:
      Phandle to the monitored battery.

  input-current-limit-microamp:
    default: 500000
    description:
      Maximum current drawn from the input supply in microamperes.

  usb-vbus:
    type: object
    $ref: /schemas/regulator/regulator.yaml#
    description:
      USB OTG 5V boost regulator.
    unevaluatedProperties: false

required:
  - compatible
  - reg
  - monitored-battery

additionalProperties: false

examples:
  - |
    #include <dt-bindings/gpio/gpio.h>
    #include <dt-bindings/interrupt-controller/irq.h>

    battery: battery {
        compatible = "simple-battery";
        constant-charge-current-max-microamp = <1800000>;
        constant-charge-voltage-max-microvolt = <4400000>;
        precharge-current-microamp = <500000>;
        charge-term-current-microamp = <200000>;
    };

    i2c {
        #address-cells = <1>;
        #size-cells = <0>;

        charger@55 {
            compatible = "qcom,smb1351-charger";
            reg = <0x55>;

            interrupt-parent = <&pio>;
            interrupts = <20 IRQ_TYPE_LEVEL_LOW>;

            enable-gpios = <&pio 166 GPIO_ACTIVE_LOW>;
            monitored-battery = <&battery>;
            input-current-limit-microamp = <1500000>;

            usb-vbus {
                regulator-name = "smb1351-usb-otg-vbus";
                regulator-min-microvolt = <5000000>;
                regulator-max-microvolt = <5000000>;
            };
        };
    };
```
