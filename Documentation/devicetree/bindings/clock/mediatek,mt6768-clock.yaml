## Documentation/devicetree/bindings/sound/mediatek,mt6768-audio.yaml
```yaml
# SPDX-License-Identifier: (GPL-2.0-only OR BSD-2-Clause)
%YAML 1.2
---
$id: http://devicetree.org/schemas/sound/mediatek,mt6768-audio.yaml#
$schema: http://devicetree.org/meta-schemas/core.yaml#

title: MediaTek AFE PCM controller for MT6768

maintainers:
  - Roman Vivchar <rva333@protonmail.com>

properties:
  compatible:
    const: mediatek,mt6768-audio

  interrupts:
    maxItems: 1

  resets:
    maxItems: 1

  reset-names:
    const: audiosys

  power-domains:
    maxItems: 1

  mediatek,topckgen:
    $ref: /schemas/types.yaml#/definitions/phandle
    description: Phandle to the topckgen controller node.

  mediatek,apmixed:
    $ref: /schemas/types.yaml#/definitions/phandle
    description: Phandle to the apmixedsys controller node.

  clocks:
    items:
      - description: AFE clock
      - description: Audio DAC clock
      - description: Audio DAC pre-distortion clock
      - description: Audio ADC clock
      - description: Audio 22M clock
      - description: Audio 24M clock
      - description: Audio PLL1 tuner clock
      - description: Audio TML clock
      - description: Audio infra AXI clock
      - description: Audio infra 26M clock
      - description: Mux for audio clock
      - description: Mux for audio internal bus clock
      - description: System PLL1 divider 4 clock
      - description: Primary audio mux
      - description: Primary audio PLL clock
      - description: Audio engine 1 clock
      - description: Audio PLL1 divider 8 clock
      - description: Mux selector for I2S port 0
      - description: Mux selector for I2S port 1
      - description: Mux selector for I2S port 2
      - description: Mux selector for I2S port 3
      - description: APLL divider 0 clock
      - description: APLL divider 1 clock
      - description: APLL divider 2 clock
      - description: APLL divider 3 clock
      - description: APMIXED APLL1 clock
      - description: 26M system clock

  clock-names:
    items:
      - const: aud_afe_clk
      - const: aud_dac_clk
      - const: aud_dac_predis_clk
      - const: aud_adc_clk
      - const: aud_apll22m_clk
      - const: aud_apll24m_clk
      - const: aud_apll1_tuner_clk
      - const: aud_tml_clk
      - const: aud_infra_axi_clk
      - const: aud_infra_26m_clk
      - const: top_mux_audio
      - const: top_mux_audio_int
      - const: top_sys_pll1_d4
      - const: top_mux_aud_1
      - const: top_apll1_ck
      - const: top_mux_aud_eng1
      - const: top_apll1_d8
      - const: top_i2s0_m_sel
      - const: top_i2s1_m_sel
      - const: top_i2s2_m_sel
      - const: top_i2s3_m_sel
      - const: top_apll12_div0
      - const: top_apll12_div1
      - const: top_apll12_div2
      - const: top_apll12_div3
      - const: apmixed_apll1
      - const: top_clk26m_clk

  pinctrl-names:
    minItems: 1
    maxItems: 16
    items:
      enum:
        - default
        - aud_clk_mosi_off
        - aud_clk_mosi_on
        - aud_clk_miso_off
        - aud_clk_miso_on
        - aud_dat_mosi_off
        - aud_dat_mosi_on
        - aud_dat_miso_off
        - aud_dat_miso_on
        - aud_gpio_i2s0_off
        - aud_gpio_i2s0_on
        - aud_gpio_i2s1_off
        - aud_gpio_i2s1_on
        - aud_gpio_i2s2_off
        - aud_gpio_i2s2_on
        - aud_gpio_i2s3_off
        - aud_gpio_i2s3_on

required:
  - compatible
  - interrupts
  - resets
  - reset-names
  - mediatek,topckgen
  - mediatek,apmixed
  - clocks
  - clock-names

additionalProperties: false

examples:
  - |
    #include <dt-bindings/clock/mediatek,mt6768-clock.h>
    #include <dt-bindings/interrupt-controller/arm-gic.h>
    #include <dt-bindings/interrupt-controller/irq.h>
    #include <dt-bindings/reset/mediatek,mt6768-resets.h>

    audio-controller {
        compatible = "mediatek,mt6768-audio";
        interrupts = <GIC_SPI 169 IRQ_TYPE_LEVEL_LOW>;
        clocks = <&audiosys CLK_AUDIO_AFE>,
                 <&audiosys CLK_AUDIO_DAC>,
                 <&audiosys CLK_AUDIO_DAC_PREDIS>,
                 <&audiosys CLK_AUDIO_ADC>,
                 <&audiosys CLK_AUDIO_22M>,
                 <&audiosys CLK_AUDIO_24M>,
                 <&audiosys CLK_AUDIO_APLL_TUNER>,
                 <&audiosys CLK_AUDIO_TML>,
                 <&infracfg_ao CLK_INFRA_AUDIO>,
                 <&infracfg_ao CLK_INFRA_AUDIO_26M_BCLK>,
                 <&topckgen CLK_TOP_AUDIO_SEL>,
                 <&topckgen CLK_TOP_AUD_INTBUS_SEL>,
                 <&topckgen CLK_TOP_SYSPLL1_D4>,
                 <&topckgen CLK_TOP_AUD_1_SEL>,
                 <&apmixedsys CLK_APMIXED_APLL1>,
                 <&topckgen CLK_TOP_AUD_ENGEN1_SEL>,
                 <&topckgen CLK_TOP_APLL1_D8>,
                 <&topckgen CLK_TOP_I2S0_M_SEL>,
                 <&topckgen CLK_TOP_I2S1_M_SEL>,
                 <&topckgen CLK_TOP_I2S2_M_SEL>,
                 <&topckgen CLK_TOP_I2S3_M_SEL>,
                 <&topckgen CLK_TOP_APLL12_DIV0>,
                 <&topckgen CLK_TOP_APLL12_DIV1>,
                 <&topckgen CLK_TOP_APLL12_DIV2>,
                 <&topckgen CLK_TOP_APLL12_DIV3>,
                 <&apmixedsys CLK_APMIXED_APLL1>,
                 <&clk26m>;
        clock-names = "aud_afe_clk", "aud_dac_clk", "aud_dac_predis_clk",
                      "aud_adc_clk", "aud_apll22m_clk", "aud_apll24m_clk",
                      "aud_apll1_tuner_clk", "aud_tml_clk",
                      "aud_infra_axi_clk", "aud_infra_26m_clk",
                      "top_mux_audio", "top_mux_audio_int",
                      "top_sys_pll1_d4", "top_mux_aud_1",
                      "top_apll1_ck", "top_mux_aud_eng1",
                      "top_apll1_d8", "top_i2s0_m_sel",
                      "top_i2s1_m_sel", "top_i2s2_m_sel",
                      "top_i2s3_m_sel", "top_apll12_div0",
                      "top_apll12_div1", "top_apll12_div2",
                      "top_apll12_div3", "apmixed_apll1",
                      "top_clk26m_clk";
        resets = <&watchdog MT6768_TOPRGU_AUDIO_SW_RST>;
        reset-names = "audiosys";
        mediatek,topckgen = <&topckgen>;
        mediatek,apmixed = <&apmixedsys>;
    };
```

## Documentation/devicetree/bindings/sound/mediatek,mt6768-sound.yaml
```yaml
# SPDX-License-Identifier: (GPL-2.0-only OR BSD-2-Clause)
%YAML 1.2
---
$id: http://devicetree.org/schemas/sound/mediatek,mt6768-sound.yaml#
$schema: http://devicetree.org/meta-schemas/core.yaml#

title: MediaTek MT6768 sound card with MT6358 codec

maintainers:
  - Roman Vivchar <rva333@protonmail.com>

properties:
  compatible:
    enum:
      - mediatek,mt6768-sound
      - mediatek,mt6768-mt6358-sound

  mediatek,platform:
    $ref: /schemas/types.yaml#/definitions/phandle
    description: Phandle to the MT6768 ASoC platform node (AFE).

  mediatek,audio-codec:
    $ref: /schemas/types.yaml#/definitions/phandle
    description: Phandle to the audio codec node (MT6358).

  mediatek,speaker-codec:
    $ref: /schemas/types.yaml#/definitions/phandle
    description: Phandle to the external speaker codec node.

required:
  - compatible
  - mediatek,platform
  - mediatek,audio-codec

additionalProperties: false

examples:
  - |
    sound {
        compatible = "mediatek,mt6768-sound";
        mediatek,platform = <&afe>;
        mediatek,audio-codec = <&mt6358codec>;
        mediatek,speaker-codec = <&cs35l41>;
    };
```
